## Kconfig
```kconfig
# SPDX-License-Identifier: GPL-3.0-or-later
menu "ESC passthrough"
    config ESC_PASSTHROUGH_UART
        int "Default hardware UART controller"
        range 0 1 if IDF_TARGET_ESP32C3
        range 0 2 if IDF_TARGET_ESP32S3
        default 1
        help
            Claimed only on valid MSP 245 and released at session end.
            Must be unused by consoles or other drivers while passthrough owns it.
            Applications can override this in esc_passthrough_config_t.
    config ESC_PASSTHROUGH_LEASE_MS
        int "Default configuration session lease (milliseconds; 0 disables)"
        range 0 3600000
        default 300000
        help
            Valid MSP/4-way packets refresh the lease. Expiry releases IO and
            reports timeout; the application must keep motor output stopped.
            Active synchronous transactions cannot expire mid-operation.
    config ESC_PASSTHROUGH_BOOT_WAIT_MS
        int "ESC bootloader entry hold (milliseconds)"
        range 0 5000
        default 2500
        help
            On hardware UART activation, drive idle ESC signals high and
            allow this interval before the first ESC operation. MSP 245
            replies immediately. AM32 can take two seconds to reset after DShot stops
            and needs a high signal to stay in its serial bootloader. A weak
            ESP pull-up alone may lose to the ESC bootloader's pull-down.
            Selected pins are released to input for communication. Zero
            disables the wait and active high parking. The application's
            watchdog/client timeouts must allow the remaining wait on the
            first ESC operation; custom IO implements its own entry.
endmenu
```

## examples/basic/main/Kconfig.projbuild
```kconfig
# SPDX-License-Identifier: GPL-3.0-or-later
menu "ESC passthrough"
    config ESC1_GPIO
        int "ESC 1 GPIO (-1 disables)"
        range -1 48
        default 0
    config ESC2_GPIO
        int "ESC 2 GPIO (-1 disables)"
        range -1 48
        default -1
    config ESC3_GPIO
        int "ESC 3 GPIO (-1 disables)"
        range -1 48
        default -1
    config ESC4_GPIO
        int "ESC 4 GPIO (-1 disables)"
        range -1 48
        default -1
    comment "Enabled slots must start at ESC 1"
endmenu
```

## examples/basic/sdkconfig.defaults
```kconfig
CONFIG_ESP_CONSOLE_NONE=y
CONFIG_ESP_CONSOLE_SECONDARY_NONE=y
CONFIG_LOG_BOOTLOADER_LEVEL_NONE=y
CONFIG_LOG_DEFAULT_LEVEL_NONE=y
CONFIG_LOG_MAXIMUM_LEVEL=0
CONFIG_FREERTOS_HZ=1000
CONFIG_ESP_MAIN_TASK_STACK_SIZE=8192
CONFIG_ESP_TASK_WDT_TIMEOUT_S=5
CONFIG_ESC1_GPIO=0
CONFIG_ESC2_GPIO=-1
CONFIG_ESC3_GPIO=-1
CONFIG_ESC4_GPIO=-1
```

## examples/dshot/main/Kconfig.projbuild
```kconfig
# SPDX-License-Identifier: GPL-3.0-or-later
menu "DShot passthrough example"
    config EXAMPLE_DSHOT_GPIO
        int "ESC signal GPIO"
        range -1 21 if IDF_TARGET_ESP32C3
        range -1 48 if IDF_TARGET_ESP32S3
        default 0 if IDF_TARGET_ESP32C3
        default 4 if IDF_TARGET_ESP32S3
        help
            The single signal wire used by DShot and ESC passthrough.
            -1 disables the example. Regular DShot300 at 1000 frames/s is fixed
            by the example; there is no signaling or bitrate selection here.
endmenu
```
